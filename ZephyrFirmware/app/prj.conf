## prj.conf
```kconfig
CONFIG_BT=y
CONFIG_BT_CTLR_TX_PWR_PLUS_4=y

CONFIG_CONSOLE=n
CONFIG_UART_CONSOLE=n
CONFIG_SERIAL=n

CONFIG_BUILD_OUTPUT_UF2=y


# Random mac gen
CONFIG_BT_PRIVACY=y
CONFIG_BT_RPA_TIMEOUT=900
CONFIG_BT_CTLR_PRIVACY=y


CONFIG_BT_GAP_PERIPHERAL_PREF_PARAMS=y

CONFIG_BT_HOST_CRYPTO=y
```

## src/main.c
```c
#include <stddef.h>
#include <zephyr/sys/printk.h>
#include <zephyr/sys/util.h>
#include <zephyr/types.h>
#include <zephyr/logging/log.h>

#include <zephyr/bluetooth/bluetooth.h>
#include <zephyr/bluetooth/hci.h>

LOG_MODULE_REGISTER(main, CONFIG_APP_LOG_LEVEL);

// This is the advertisement key / EID. Change it to your own EID.
const char *eid_string = "INSERT_YOUR_ADVERTISEMENT_KEY_HERE";

void hex_string_to_bytes(const char *hex, uint8_t *bytes, size_t len) {
  for (size_t i = 0; i < len; i++) {
    sscanf(hex + 2 * i, "%2hhx", &bytes[i]);
  }
}

struct bt_le_adv_param adv_param = {
    .options = 0, 
    .interval_min = 3200,
    .interval_max = 3200,
};

typedef struct __attribute__((packed)) {
  uint8_t flags_data;
} fmdn_flags_data_t;

/* Adv Frame, see https://developers.google.com/nearby/fast-pair/specifications/extensions/fmdn#advertised-frames */
typedef struct __attribute__((packed)) {
  uint16_t service_uuid;
  uint8_t frame_type;
  uint8_t eid[20];
  uint8_t hashed_flags;
} fmdn_service_data_t;

fmdn_flags_data_t fmdn_flags_data = {.flags_data = 0x06};
fmdn_service_data_t fmdn_service_data = {.service_uuid = 0xFEAA, .frame_type = 0x41, .hashed_flags = 0x0};

static const struct bt_data adv_data[] = {
    BT_DATA(BT_DATA_FLAGS, (unsigned char *)&fmdn_flags_data, sizeof(fmdn_flags_data)),
    BT_DATA(BT_DATA_SVC_DATA16, (unsigned char *)&fmdn_service_data, sizeof(fmdn_service_data)),

};

int main(void) {
    int err;

    hex_string_to_bytes(eid_string, fmdn_service_data.eid, 20);

    err = bt_enable(NULL);
    if (err) {
        LOG_ERR("Bluetooth init failed (err %d)\n", err);
        return 0;
    }

    printk("Bluetooth initialized. Starting rotation loop...\n");


    while (1) {
        err = bt_le_adv_start(&adv_param, adv_data, ARRAY_SIZE(adv_data), NULL, 0);
        if (err) {
            LOG_ERR("Advertising failed to start (err %d)", err);
            k_sleep(K_SECONDS(10));
            continue;
        }
        
        printk("Advertising started with NEW address\n");

        k_sleep(K_SECONDS(900));

        err = bt_le_adv_stop();
        if (err) {
            LOG_ERR("Advertising failed to stop (err %d)", err);
        }
        
        printk("Advertising stopped. Rotating...\n");
        
        k_sleep(K_SECONDS(1));
    }
}
```
